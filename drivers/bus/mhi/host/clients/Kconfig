## drivers/bus/mhi/host/clients/Kconfig
```kconfig
menu "MHI host client drivers"

source "drivers/bus/mhi/host/clients/sahara/Kconfig"

endmenu
```

## drivers/bus/mhi/host/clients/sahara/Kconfig
```kconfig
config MHI_SAHARA
	tristate "Sahara protocol driver"
	depends on MHI_BUS
	help
	  Enable support for the Sahara protocol transported over the MHI bus.

	  The Sahara protocol is used to transfer firmware images, retrieve
	  memory dumps and exchange command mode DDR calibration data between
	  host and device. This driver is not tied to a specific SoC and may be
	  used by multiple MHI based devices.

	  If unsure, say N.

	  To compile this driver as a module, choose M here: the module will be
	  called mhi_sahara.
```
